/ {
    led_reg: led_regulator {
        compatible = "regulator-fixed";
        regulator-name = "led_reg";
        enable-gpios = <&gpio0 14 GPIO_ACTIVE_LOW>;
        startup-delay-us = <0>;
        status = "okay";
    };
};
